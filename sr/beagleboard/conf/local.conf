## sr/beagleboard/conf/local.conf
```bitbake
DISTRO = "angstrom-2008.1"
BBFILES = "${OE_HOME}/openembedded/recipes/*/*.bb ${OE_HOME}/sr/recipes/*/*.bb"

BBFILE_COLLECTIONS = "upstream sr"
BBFILE_PATTERN_upstream = "^${OE_HOME}/openembedded/"
BBFILE_PRIORITY_upstream = "5"

BBFILE_PATTERN_sr = "^${OE_HOME}/sr/"
BBFILE_PRIORITY_sr = "10"

TMPDIR = "${OE_HOME}/tmp"
MACHINE = "beagleboard"
ENABLE_BINARY_LOCALE_GENERATION = "0"

# Enable development shell for everything
INHERIT += "devshell"

PREFERRED_VERSION_linux-omap = "2.6.29"
PREFERRED_PROVIDER_virtual/bootloader = "u-boot"

# BB_NUMBER_THREADS = "8"
# PARALLEL_MAKE = "-j 5"
```
